## firmware/sdkconfig.defaults
```kconfig
# ==
# Secure IoT Firmware - Base Configuration
# ==

# Target
CONFIG_IDF_TARGET_ESP32=y

# --
# Logging
# --
CONFIG_LOG_DEFAULT_LEVEL_INFO=y
CONFIG_LOG_MAXIMUM_LEVEL_INFO=y

# --
# FreeRTOS
# --
CONFIG_FREERTOS_HZ=100
CONFIG_FREERTOS_USE_TRACE_FACILITY=n

# --
# mbedTLS (REQUIRED)
# --
CONFIG_MBEDTLS=y
CONFIG_MBEDTLS_PEM_PARSE_C=y
CONFIG_MBEDTLS_X509_CRT_PARSE_C=y
CONFIG_MBEDTLS_PK_PARSE_C=y
CONFIG_MBEDTLS_SSL_PROTO_TLS1_2=y
CONFIG_MBEDTLS_SSL_PROTO_TLS1_3=n

# Strong crypto
CONFIG_MBEDTLS_ECP_DP_SECP256R1_ENABLED=y
CONFIG_MBEDTLS_ECDSA_C=y
CONFIG_MBEDTLS_SHA256_C=y

# Disable legacy / weak crypto
CONFIG_MBEDTLS_SSL_PROTO_SSL3=n
CONFIG_MBEDTLS_SSL_PROTO_TLS1=n
CONFIG_MBEDTLS_SSL_PROTO_TLS1_1=n

# --
# OTA / Image verification
# --
CONFIG_ESP32_REV_MIN_0=y
CONFIG_ESP_IMAGE_VERIFY=y

# --
# Security hygiene
# --
CONFIG_COMPILER_STACK_CHECK_MODE_STRONG=y
CONFIG_STACK_CHECK=y
CONFIG_ESP_SYSTEM_PANIC_PRINT_REBOOT=y

# --
# Disable noise
# --
CONFIG_ESP_TASK_WDT=n
CONFIG_ESP_SYSTEM_MEMPROT_FEATURE=n
```
